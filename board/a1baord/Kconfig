## board/a1baord/Kconfig
```kconfig
if TARGET_A1BOARD

config SYS_BOARD
	default "a1board"

config SYS_VENDOR
	default "ARL"

config SYS_SOC
	default "mx6"

config SYS_CONFIG_NAME
	default "a1board"

endif
```

## board/mx6_a1board/Kconfig
```kconfig
if TARGET_MX6_A1BOARD


config SYS_BOARD
	default "mx6_a1board"

config SYS_VENDOR
	default "freescale"

config SYS_SOC
	default "mx6"

config SYS_CONFIG_NAME
	default "mx6_a1board"

endif
```

## board/rsp-systems/mx6_rsp/Kconfig
```kconfig
if TARGET_MX6_RSP

config SYS_BOARD
	default "mx6_rsp"

config SYS_VENDOR
	default "rsp-systems"

config SYS_CONFIG_NAME
	default "mx6_rsp"

endif
```

## configs/mx6_a1board_defconfig
```kconfig
CONFIG_ARM=y
CONFIG_TARGET_MX6_A1BOARD=y
CONFIG_SPL=y
CONFIG_SYS_EXTRA_OPTIONS="IMX_CONFIG=arch/arm/mach-imx/spl_sd.cfg,MX6UL"
CONFIG_DM=y
CONFIG_DM_THERMAL=y
```
